## boards/mind/mindos_n6/Kconfig.defconfig
```kconfig
# STM32N657X0_Q Nucleo board configuration

# Copyright (c) 2025 STMicroelectronics
# SPDX-License-Identifier: Apache-2.0

if BOARD_MINDOS_N6

configdefault ETH_DRIVER
	default y

configdefault OTP
	default y if ETH_STM32_HAL && NVMEM

endif # BOARD_MINDOS_N6
```

## boards/mind/mindos_n6/Kconfig.mindos_n6
```kconfig
# STM32N657X0_Q Nucleo board configuration

# Copyright (c) 2024 STMicroelectronics
# SPDX-License-Identifier: Apache-2.0

config BOARD_MINDOS_N6
	select SOC_STM32N657XX
```

## boards/mind/mindos_n6/Kconfig.sysbuild
```kconfig
# Copyright The Zephyr Project Contributors
# SPDX-License-Identifier: Apache-2.0

if BOARD_MINDOS_N6_STM32N657XX

choice BOOTLOADER
	default BOOTLOADER_MCUBOOT
endchoice

endif # BOARD_MINDOS_N6_STM32N657XX
```

## boards/mind/mindos_n6/board.yml
```yaml
board:
  name: mindos_n6
  full_name: MindOS N657L0 MCU Board
  vendor: st
  socs:
    - name: stm32n657xx
      variants:
        - name: sb
```

## boards/mind/mindos_n6/mindos_n6_stm32n657xx_fsbl_defconfig
```kconfig
# Copyright The Zephyr Project Contributors
# SPDX-License-Identifier: Apache-2.0

# Enable UART driver
CONFIG_SERIAL=y

# Enable GPIO for hogs
CONFIG_GPIO=y

# Console
CONFIG_CONSOLE=y
CONFIG_UART_CONSOLE=y

# Enable MPU
CONFIG_ARM_MPU=y

# Enable HW stack protection
CONFIG_HW_STACK_PROTECTION=y

# Loaded into internal RAM by the boot ROM
CONFIG_XIP=n

# HAL needs TRUSTED_EXECUTION_SECURE explicitly enabled
CONFIG_TRUSTED_EXECUTION_SECURE=y
```

## boards/others/zrobot_obc/Kconfig.defconfig
```kconfig
# black_f407ve board configuration

# Copyright (c) 2020 Intel Corporation
# SPDX-License-Identifier: Apache-2.0

if BOARD_ZROBOT_OBC

config SPI_STM32_INTERRUPT
	default y
	depends on SPI

endif # ZROBOT_OBC
```

## boards/others/zrobot_obc/board.yml
```yaml
board:
  name: zrobot_obc
  full_name: zrobot obc  F407VE Development Board
  vendor: others
  socs:
    - name: stm32f407xx
```

## boards/st/nucleo_n657x0_q/Kconfig.sysbuild
```kconfig
# SPDX-License-Identifier: Apache-2.0
# Copyright (c) 2025 STMicroelectronics

if BOARD_NUCLEO_N657X0_Q

choice BOOTLOADER
        default BOOTLOADER_MCUBOOT
endchoice

endif
```

## boards/weact/bluepill_stm32f103c8t6/board.yml
```yaml
board:
  name: bluepill_stm32f103c8t6
  full_name: Blue Pill
  vendor: weact
  socs:
    - name: stm32f103xb
```

## drivers/clock_control/Kconfig.si5351
```kconfig
# Copyright (c) 2024 Silicon Laboratories Inc.
# SPDX-License-Identifier: Apache-2.0

config CLOCK_CONTROL_SILABS_SI5351
	bool "Silicon Labs Si5351 programmable clock generator"
	default y
	depends on DT_HAS_SILABS_SI5351_CLOCK_ENABLED
	help
	  Enable Silicon Labs SI5351 programmable clock generator.
```

## drivers/oscilator/Kconfig
```kconfig
# Copyright (c) 2025 Javad Rahimipetroudi <javad.rahimipetroudi@gmail.com>
# SPDX-License-Identifier: Apache-2.0

# Top-level configuration file for oscilator drivers.

menuconfig OSC 
	bool "Oscilators  drivers"
	help
	  Include Oscilator and clock generator drivers in the system configuration.

if OSC

module = OSC
module-str = osc
source "subsys/logging/Kconfig.template.log_config"

config OSC_INIT_PRIORITY
	int "Oscilator initialization priority"
	default 90
	help
	  System initialization priority for oscilator drivers.

config OSC_SHELL
	bool "OSC shell"
	depends on SHELL
	help
	  Enable oscilator shell for testing.

source "drivers/led/Kconfig.si5351"

endif # OSC 
```

## drivers/oscilator/Kconfig.si5351
```kconfig
# Copyright (c) 2025 Javad Rahimi <javad.rahimipetroudi@mind.be>
# SPDX-License-Identifier: Apache-2.0

menuconfig SI5351
	bool "SI5351 clock generator driver"
	default y
	depends on DT_HAS_SKYWORKS_SI5351_ENABLED
	select I2C
	help
	  Enable clock generator driver for SI5351.

	  The Si5351 is an I2 C configurable clock generator that is
	  ideally suited for replacing crystals, crystal oscillators,
	  VCXOs, phase-locked loops (PLLs), and fanout buffers in
	  cost-sensitive applications
```

## drivers/rf/Kconfig
```kconfig
#
# Copyright (c) 2026 Javad Rahimipetroudi
#
# SPDX-License-Identifier: Apache-2.0
#

# Top-level configuration file for RF module drivers.

menuconfig RF
	bool "RF drivers"
	select POLL
	help
	  Include RF drivers in the system configuration.

if RF


module = RF
module-str = rf
source "subsys/logging/Kconfig.template.log_config"

config RF_SHELL
	bool "RF Shell"
	depends on SHELL
	help
	  Enable RF Shell for testing.

config RF_INIT_PRIORITY
	int "RF initialization priority"
	default 90
	help
	  System initialization priority for RF module drivers.

rsource "Kconfig.nrf24l1"

endif # RF
```

## drivers/rf/Kconfig.nrf24l1
```kconfig
#
# Copyright (c) 2026  Javad Rahimipetroudi
#
# SPDX-License-Identifier: Apache-2.0
#

config NORDIC_NRF24L01
        bool "Nordic NRF24L1 RF module"
        default y
        depends on DT_HAS_NORDIC_NRF24L01_ENABLED
        select GPIO
        select SPI
        help
          Enable the Nordic NRF24L01 driver

if NORDIC_NRF24L01

config NRF24L01_TRIGGER
	bool "NRF24 trigger with irq gpio"
	depends on NORDIC_NRF24L01
	help
	  When enabled, the NRF24L01 read is triggered by irq gpio and
	  not by polling.

config NRF24L01_READ_TIMEOUT
	int "Timout for read operation"
	depends on NRF24L01_TRIGGER
	default 1000
	help
	  nRF24 timeout for reading, in ms.

config NRF24L01_WRITE_TIMEOUT
	int "Timout for write operation"
	depends on NRF24L01_TRIGGER
	default 100
	help
	  nRF24 timeout for writing, in ms.
endif   # NORDIC_NRF24L01
```

## dts/bindings/rf/nordic,nrf24l1.yaml
```yaml
# Copyright (c) 2019, Manivannan Sadhasivam
# Copyright (c) 2020, Grinn
# SPDX-License-Identifier: Apache-2.0

include: spi-device.yaml
compatible: "nordic,nrf24l1"
description: Nordic nRF24L1 series RF module.

properties:
  ce-gpios:
    type: phandle-array
    required: true
    description: |
      GPIO connected to the modem's CE pin.

      This signal is open-drain, active-high (NRF24L1).

  csn-gpios:
    type: phandle-array
    required: true
    description: |
      Chip enable pin.

      These signals are normally active-high.
  irq-gpios:
    type: phandle-array
    required: true
    description: |
      Intrep request pin for NRF24L
```

## subsys/bluetooth/services/Kconfig.bps
```kconfig
config BT_BPS
    bool "Blood Pressure Service (BPS)"
    help
      Enable the Bluetooth Blood Pressure Service (BPS).
      Implements the Bluetooth SIG BPS 1.0 specification
      with Blood Pressure Measurement, and Blood Pressure
      Feature characteristics.
```
