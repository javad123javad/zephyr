## CMakeLists.txt
```
# SPDX-License-Identifier: Apache-2.0

cmake_minimum_required(VERSION 3.20.0)

find_package(Zephyr REQUIRED HINTS $ENV{ZEPHYR_BASE})
project(st_dmic)

target_sources(app PRIVATE src/main.c 
    src/stm32wb5mm_dk_conf.h
    src/stm32wb5mm_dk_errno.h
    src/stm32wb5mm_dk_audio.h
    src/stm32wb5mm_dk_audio.c)

zephyr_library_import(lib ${CMAKE_CURRENT_SOURCE_DIR}/src/libPDMFilter_CM4_GCC_wc16_softfp.a)
target_link_libraries(app PRIVATE lib)
```

## Kconfig
```
mainmenu "ST-DMIC"

	source "Kconfig.zephyr"
	config ST_DMIC_STM32
	default y
	bool
	select USE_STM32_HAL_SAI
	select USE_STM32_HAL_GPIO
	select USE_STM32_HAL_DMA
	select USE_STM32_HAL_NVIC
	select USE_STM32_HAL_PWR
	select USE_STM32_HAL_CORTEX
	select USE_STM32_HAL_PWR_EX
	select USE_STM32_HAL_CRC
```

## Kconfig.sai
```
mainmenu "ST-DMIC"

	source "Kconfig.zephyr"
	config ST_DMIC_STM32
	default y
	bool
	select USE_STM32_HAL_SAI
```

## prj.conf
```kconfig
CONFIG_AUDIO=y
CONFIG_AUDIO_DMIC=y

CONFIG_LOG=y

CONFIG_AUDIO_MPXXDTYY=y
CONFIG_CMSIS_DSP=y
CONFIG_CMSIS_DSP_FILTERING=y
```

## src/main.c
```c
/*
 * Copyright (c) 2021 Nordic Semiconductor ASA
 *
 * SPDX-License-Identifier: Apache-2.0
 */

#include <zephyr/kernel.h>
#include <soc.h>
#include <stm32wbxx_hal_sai.h>

#include <zephyr/logging/log.h>
#include "stm32wb5mm_dk_audio.h"
#include "stm32wb5mm_dk_errno.h"

LOG_MODULE_REGISTER(dmic_sample);
BSP_AUDIO_Init_t MicParams;
uint16_t PDM_Buffer[((((2 * AUDIO_IN_CHANNELS * AUDIO_IN_SAMPLING_FREQUENCY) / 1000) * MAX_DECIMATION_FACTOR) / 16)* N_MS_PER_INTERRUPT ];
// SAI_HandleTypeDef hsai_BlockA1;
// DMA_HandleTypeDef hdma_sai1_a;


void SystemClock_Config(void)
{
    RCC_OscInitTypeDef RCC_OscInitStruct = {0};
    RCC_ClkInitTypeDef RCC_ClkInitStruct = {0};

    /** Configure the main internal regulator output voltage
    */
    __HAL_PWR_VOLTAGESCALING_CONFIG(PWR_REGULATOR_VOLTAGE_SCALE1);

    /** Initializes the RCC Oscillators according to the specified parameters
    * in the RCC_OscInitTypeDef structure.
    */
    RCC_OscInitStruct.OscillatorType = RCC_OSCILLATORTYPE_HSI|RCC_OSCILLATORTYPE_HSE;
    RCC_OscInitStruct.HSEState = RCC_HSE_ON;
    RCC_OscInitStruct.HSIState = RCC_HSI_ON;
    RCC_OscInitStruct.HSICalibrationValue = RCC_HSICALIBRATION_DEFAULT;
    RCC_OscInitStruct.PLL.PLLState = RCC_PLL_ON;
    RCC_OscInitStruct.PLL.PLLSource = RCC_PLLSOURCE_HSE;
    RCC_OscInitStruct.PLL.PLLM = RCC_PLLM_DIV2;
    RCC_OscInitStruct.PLL.PLLN = 8;
    RCC_OscInitStruct.PLL.PLLP = RCC_PLLP_DIV2;
    RCC_OscInitStruct.PLL.PLLR = RCC_PLLR_DIV2;
    RCC_OscInitStruct.PLL.PLLQ = RCC_PLLQ_DIV2;
    if (HAL_RCC_OscConfig(&RCC_OscInitStruct) != HAL_OK)
    {
        // Error_Handler();
        printk("Error HAL_RCC_OscConfig\n");
    }

    /** Configure the SYSCLKSource, HCLK, PCLK1 and PCLK2 clocks dividers
    */
    RCC_ClkInitStruct.ClockType = RCC_CLOCKTYPE_HCLK4|RCC_CLOCKTYPE_HCLK2
                                  |RCC_CLOCKTYPE_HCLK|RCC_CLOCKTYPE_SYSCLK
                                  |RCC_CLOCKTYPE_PCLK1|RCC_CLOCKTYPE_PCLK2;
    RCC_ClkInitStruct.SYSCLKSource = RCC_SYSCLKSOURCE_PLLCLK;
    RCC_ClkInitStruct.AHBCLKDivider = RCC_SYSCLK_DIV1;
    RCC_ClkInitStruct.APB1CLKDivider = RCC_HCLK_DIV1;
    RCC_ClkInitStruct.APB2CLKDivider = RCC_HCLK_DIV1;
    RCC_ClkInitStruct.AHBCLK2Divider = RCC_SYSCLK_DIV2;
    RCC_ClkInitStruct.AHBCLK4Divider = RCC_SYSCLK_DIV1;

    if (HAL_RCC_ClockConfig(&RCC_ClkInitStruct, FLASH_LATENCY_3) != HAL_OK)
    {
        printk("Error Clock init....\n");
    }

    /** Enables the Clock Security System
    */
    HAL_RCC_EnableCSS();
}

void PeriphCommonClock_Config(void)
{
    RCC_PeriphCLKInitTypeDef PeriphClkInitStruct = {0};

    /** Initializes the peripherals clock
    */
    PeriphClkInitStruct.PeriphClockSelection = RCC_PERIPHCLK_SMPS;
    PeriphClkInitStruct.SmpsClockSelection = RCC_SMPSCLKSOURCE_HSI;
    PeriphClkInitStruct.SmpsDivSelection = RCC_SMPSCLKDIV_RANGE1;

    if (HAL_RCCEx_PeriphCLKConfig(&PeriphClkInitStruct) != HAL_OK)
    {
        printk("Error PeriphCommonClock_Config\n");
    }
    /* USER CODE BEGIN Smps */

    /* USER CODE END Smps */
}

static void MX_GPIO_Init(void)
{
/* USER CODE BEGIN MX_GPIO_Init_1 */
/* USER CODE END MX_GPIO_Init_1 */

  /* GPIO Ports Clock Enable */
  __HAL_RCC_GPIOC_CLK_ENABLE();
  __HAL_RCC_GPIOB_CLK_ENABLE();
  __HAL_RCC_GPIOA_CLK_ENABLE();

/* USER CODE BEGIN MX_GPIO_Init_2 */
/* USER CODE END MX_GPIO_Init_2 */
}

static void MX_DMA_Init(void)
{

  /* DMA controller clock enable */
  __HAL_RCC_DMAMUX1_CLK_ENABLE();
  __HAL_RCC_DMA1_CLK_ENABLE();

  /* DMA interrupt init */
  /* DMA1_Channel2_IRQn interrupt configuration */
  HAL_NVIC_SetPriority(DMA1_Channel2_IRQn, 0, 0);
  HAL_NVIC_EnableIRQ(DMA1_Channel2_IRQn);

}

static void MX_SAI1_Init(void)
{

  /* USER CODE BEGIN SAI1_Init 0 */

  /* USER CODE END SAI1_Init 0 */

  /* USER CODE BEGIN SAI1_Init 1 */

  /* USER CODE END SAI1_Init 1 */
  hAudioInSai.Instance = SAI1_Block_A;
  hAudioInSai.Init.Protocol = SAI_FREE_PROTOCOL;
  hAudioInSai.Init.AudioMode = SAI_MODEMASTER_RX;
  hAudioInSai.Init.DataSize = SAI_DATASIZE_8;
  hAudioInSai.Init.FirstBit = SAI_FIRSTBIT_MSB;
  hAudioInSai.Init.ClockStrobing = SAI_CLOCKSTROBING_FALLINGEDGE;
  hAudioInSai.Init.Synchro = SAI_ASYNCHRONOUS;
  hAudioInSai.Init.OutputDrive = SAI_OUTPUTDRIVE_DISABLE;
  hAudioInSai.Init.NoDivider = SAI_MASTERDIVIDER_ENABLE;
  hAudioInSai.Init.MckOverSampling = SAI_MCK_OVERSAMPLING_DISABLE;
  hAudioInSai.Init.FIFOThreshold = SAI_FIFOTHRESHOLD_EMPTY;
  hAudioInSai.Init.AudioFrequency = SAI_AUDIO_FREQUENCY_192K;
  hAudioInSai.Init.MonoStereoMode = SAI_STEREOMODE;
  hAudioInSai.Init.CompandingMode = SAI_NOCOMPANDING;
  hAudioInSai.Init.PdmInit.Activation = ENABLE;
  hAudioInSai.Init.PdmInit.MicPairsNbr = 1;
  hAudioInSai.Init.PdmInit.ClockEnable = SAI_PDM_CLOCK1_ENABLE;
  hAudioInSai.FrameInit.FrameLength = 8;
  hAudioInSai.FrameInit.ActiveFrameLength = 1;
  hAudioInSai.FrameInit.FSDefinition = SAI_FS_STARTFRAME;
  hAudioInSai.FrameInit.FSPolarity = SAI_FS_ACTIVE_LOW;
  hAudioInSai.FrameInit.FSOffset = SAI_FS_FIRSTBIT;
  hAudioInSai.SlotInit.FirstBitOffset = 0;
  hAudioInSai.SlotInit.SlotSize = SAI_SLOTSIZE_DATASIZE;
  hAudioInSai.SlotInit.SlotNumber = 1;
  hAudioInSai.SlotInit.SlotActive = 0x00000000;
  if (HAL_SAI_Init(&hAudioInSai) != HAL_OK)
  {
    // Error_Handler();
    printk("Error HAL_SAI_Init\n");

  }
  /* USER CODE BEGIN SAI1_Init 2 */

  /* USER CODE END SAI1_Init 2 */

}

/////////////////////////////
static void Init_Acquisition_Peripherals(uint32_t AudioFreq, uint32_t ChnlNbrIn, uint32_t ChnlNbrOut)
{
    int fret = 0;

    MicParams.BitsPerSample = 16;
    MicParams.ChannelsNbr = ChnlNbrIn;
    MicParams.Device = AUDIO_IN_DIGITAL_MIC;
    MicParams.SampleRate = AudioFreq;
    MicParams.Volume = AUDIO_VOLUME_INPUT;

    fret = BSP_AUDIO_IN_Init(BSP_AUDIO_INSTANCE, &MicParams);
    if ( fret != BSP_ERROR_NONE)
    {
        // Error_Handler();
        printk("Error BSP_AUDIO_IN_Init: %d\n", fret);
    }
}

static void Start_Acquisition(void)
{
    int fret = 0;
    fret = BSP_AUDIO_IN_Record(BSP_AUDIO_INSTANCE, (uint8_t *) PDM_Buffer, AUDIO_IN_BUFFER_SIZE);
    if (fret != BSP_ERROR_NONE)
    {
        printk("Error in BSP_AUDIO_IN_Record: %d\n", fret);
    }
}
int main(void)
{
    int fret = 0;

    // HAL_Init();

    // SystemClock_Config();

    PeriphCommonClock_Config();
    // MX_GPIO_Init();
    // MX_DMA_Init();
    // MX_SAI1_Init();

    printk("Start Init_Acquisition_Peripherals...\n");
    // Init_Acquisition_Peripherals(AUDIO_IN_SAMPLING_FREQUENCY, AUDIO_IN_CHANNELS, 0);
    printk("Init_Acquisition_Peripherals finished...\n");

    printk("Start Audio acquisition...\n");
    Start_Acquisition();
    printk("Init Clock: %d\n", fret);
    return 0;
}
```

## src/stm32wb5mm_dk_audio.h
```c
/**
  ******************************************************************************
  * @file    stm32wb5mm_dk_audio.h
  * @author  MCD Application Team
  * @brief   This file contains the common defines and functions prototypes for
  *          the stm32wb5mm_dk_audio.c driver.
  ******************************************************************************
  * @attention
  *
  * Copyright (c) 2021 STMicroelectronics.
  * All rights reserved.
  *
  * This software is licensed under terms that can be found in the LICENSE file
  * in the root directory of this software component.
  * If no LICENSE file comes with this software, it is provided AS-IS.
  *
  ******************************************************************************
  */

/* Define to prevent recursive inclusion -------------------------------------*/
#ifndef STM32WB5MM_DK_AUDIO_H
#define STM32WB5MM_DK_AUDIO_H

#ifdef __cplusplus
 extern "C" {
#endif

/* Includes ------------------------------------------------------------------*/
#include "stm32wb5mm_dk_conf.h"
#include <stdlib.h>
#include "pdm2pcm_glo.h"


/** @addtogroup BSP
  * @{
  */

/** @addtogroup STM32WB5MM_DK
  * @{
  */

/** @defgroup STM32WB5MM_DK_AUDIO STM32WB5MM_DK AUDIO
  * @{
  */

/** @defgroup STM32WB5MM_DK_AUDIO_Exported_Variables STM32WB5MM_DK AUDIO Exported Variables
  * @{
  */
extern SAI_HandleTypeDef            hAudioInSai;
extern DMA_HandleTypeDef hSaiDma;

typedef struct
{
  uint32_t                    Device;
  uint32_t                    SampleRate;
  uint32_t                    BitsPerSample;
  uint32_t                    ChannelsNbr;
  uint32_t                    Volume;
}BSP_AUDIO_Init_t;

typedef struct
{
  uint32_t                    Instance;            /* Audio IN instance              */
  uint32_t                    Device;              /* Audio IN device to be used     */
  uint32_t                    SampleRate;          /* Audio IN Sample rate           */
  uint32_t                    BitsPerSample;       /* Audio IN Sample resolution     */
  uint32_t                    ChannelsNbr;         /* Audio IN number of channel     */
  uint16_t                    *pBuff;              /* Audio IN record buffer         */
  uint32_t                    Size;                /* Audio IN record buffer size    */
  uint32_t                    Volume;              /* Audio IN volume                */
  uint32_t                    State;               /* Audio IN State                 */
  uint32_t                    IsMspCallbacksValid; /* Is Msp Callbacks registered     */
  uint32_t DecimationFactor;
}AUDIO_IN_Ctx_t;

#if ((USE_HAL_SAI_REGISTER_CALLBACKS == 1))
typedef struct
{
  pSAI_CallbackTypeDef            pMspSaiInitCb;
  pSAI_CallbackTypeDef            pMspSaiDeInitCb;
}BSP_AUDIO_IN_Cb_t;
#endif /* ((USE_HAL_SAI_REGISTER_CALLBACKS == 1)) */

/**
  * @}
  */

/** @defgroup STM32WB5MM_DK_AUDIO_Exported_Constants STM32WB5MM_DK AUDIO Exported Constants
  * @{
  */
#define DMA_MAX(_X_)                (((_X_) <= DMA_MAX_SZE)? (_X_):DMA_MAX_SZE)
#define HTONS(A)  ((((A) & (uint16_t)0xff00) >> 8) | (((A) & (uint16_t)0x00ff) << 8))

/* AUDIO FREQUENCY */
#define AUDIO_FREQUENCY_192K      (uint32_t)192000U
#define AUDIO_FREQUENCY_176K      (uint32_t)176400U
#define AUDIO_FREQUENCY_96K       (uint32_t)96000U
#define AUDIO_FREQUENCY_88K       (uint32_t)88200U
#define AUDIO_FREQUENCY_48K       (uint32_t)48000U
#define AUDIO_FREQUENCY_44K       (uint32_t)44100U
#define AUDIO_FREQUENCY_32K       (uint32_t)32000U
#define AUDIO_FREQUENCY_22K       (uint32_t)22050U
#define AUDIO_FREQUENCY_16K       (uint32_t)16000U
#define AUDIO_FREQUENCY_11K       (uint32_t)11025U
#define AUDIO_FREQUENCY_8K        (uint32_t)8000U 

/* AUDIO RESOLUTION */
#define AUDIO_RESOLUTION_16b                16U
#define AUDIO_RESOLUTION_24b                24U
#define AUDIO_RESOLUTION_32b                32U

/*------------------------------------------------------------------------------
                        AUDIO IN defines parameters
------------------------------------------------------------------------------*/

/* SAI Configuration defines */
#define AUDIO_IN_SAI_INSTANCE                                    SAI1_Block_A
#define AUDIO_IN_SAI_CLK_ENABLE()                                __SAI1_CLK_ENABLE()
#define AUDIO_IN_SAI_SCK_PIN                                     GPIO_PIN_8
#define AUDIO_IN_SAI_SCK_GPIO_PORT                               GPIOA
#define AUDIO_IN_SAI_SCK_GPIO_CLK_ENABLE()                       __GPIOA_CLK_ENABLE()
#define AUDIO_IN_SAI_SCK_AF                                      GPIO_AF3_SAI1

#define AUDIO_IN_SAI_SD2_PIN                                    GPIO_PIN_9
#define AUDIO_IN_SAI_SD2_GPIO_PORT                              GPIOA
#define AUDIO_IN_SAI_SD2_GPIO_CLK_ENABLE()                      __GPIOA_CLK_ENABLE();
#define AUDIO_IN_SAI_SD2_AF                                     GPIO_AF3_SAI1

/* SAI DMA definitions */
#define AUDIO_IN_SAI_DMAx_CLK_ENABLE()                          __DMA1_CLK_ENABLE()
#define AUDIO_IN_SAI_DMAx_PERIPH_DATA_SIZE                      DMA_PDATAALIGN_BYTE
#define AUDIO_IN_SAI_DMAx_MEM_DATA_SIZE                         DMA_MDATAALIGN_BYTE

/* Audio In devices */
#ifndef AUDIO_IN_CHANNELS
#define AUDIO_IN_CHANNELS 1
#endif
#ifndef AUDIO_IN_SAMPLING_FREQUENCY
#define AUDIO_IN_SAMPLING_FREQUENCY 16000
#endif
#define AUDIO_IN_BIT_DEPTH              AUDIO_RESOLUTION_16b
#define AUDIO_VOLUME_INPUT              64U
#define BSP_AUDIO_INSTANCE              0U
#define BSP_AUDIO_IN_IT_PRIORITY        6U
#define AUDIO_IN_DIGITAL_MIC            0x10U
#define CHANNEL_DEMUX_MASK              0x55U

#define ENABLE_HIGH_PERFORMANCE_MODE    0U
#if (ENABLE_HIGH_PERFORMANCE_MODE == 1U)
#define PDM_FREQ_16K                    1536
#endif

#ifndef PDM_FREQ_16K
#define PDM_FREQ_16K                    1280
#endif

/*Number of millisecond of audio at each DMA interrupt*/
#define N_MS_PER_INTERRUPT               (20U)

/* Default Audio IN internal buffer size */
#define DEFAULT_AUDIO_IN_BUFFER_SIZE        (uint32_t)((AUDIO_IN_SAMPLING_FREQUENCY/1000)*2)*N_MS_PER_INTERRUPT

/* Audio In states */
#define AUDIO_IN_STATE_RESET               0U
#define AUDIO_IN_STATE_RECORDING           1U
#define AUDIO_IN_STATE_STOP                2U
#define AUDIO_IN_STATE_PAUSE               3U

/* Audio In instances number:
   Instance 0 is SAI
 */
#define AUDIO_IN_INSTANCES_NBR             1U
/**
  * @}
  */

/** @addtogroup STM32WB5MM_DK_AUDIO_Exported_Variables
  * @{
  */
/* Recording context */
extern AUDIO_IN_Ctx_t                         AudioInCtx[];
/**
  * @}
  */

/** @defgroup STM32WB5MM_DK_AUDIO_IN_Exported_Functions STM32WB5MM_DK AUDIO IN Exported Functions
  * @{
  */
int32_t BSP_AUDIO_IN_Init(uint32_t Instance, BSP_AUDIO_Init_t* AudioInit);
int32_t BSP_AUDIO_IN_DeInit(uint32_t Instance);
#if ((USE_HAL_SAI_REGISTER_CALLBACKS == 1U))
int32_t BSP_AUDIO_IN_RegisterDefaultMspCallbacks (uint32_t Instance);
int32_t BSP_AUDIO_IN_RegisterMspCallbacks (uint32_t Instance, BSP_AUDIO_IN_Cb_t *CallBacks);
#endif /* ((USE_HAL_SAI_REGISTER_CALLBACKS == 1U)) */
int32_t BSP_AUDIO_IN_Record(uint32_t Instance, uint8_t* pBuf, uint32_t NbrOfBytes);
int32_t BSP_AUDIO_IN_Stop(uint32_t Instance);
int32_t BSP_AUDIO_IN_Pause(uint32_t Instance);
int32_t BSP_AUDIO_IN_Resume(uint32_t Instance);

int32_t BSP_AUDIO_IN_RecordChannels(uint32_t Instance, uint8_t **pBuf, uint32_t NbrOfBytes);
int32_t BSP_AUDIO_IN_StopChannels(uint32_t Instance, uint32_t Device);
int32_t BSP_AUDIO_IN_PauseChannels(uint32_t Instance, uint32_t Device);
int32_t BSP_AUDIO_IN_ResumeChannels(uint32_t Instance, uint32_t Device);

int32_t BSP_AUDIO_IN_SetDevice(uint32_t Instance, uint32_t Device);
int32_t BSP_AUDIO_IN_GetDevice(uint32_t Instance, uint32_t *Device);
int32_t BSP_AUDIO_IN_SetSampleRate(uint32_t Instance, uint32_t SampleRate);
int32_t BSP_AUDIO_IN_GetSampleRate(uint32_t Instance, uint32_t *SampleRate);
int32_t BSP_AUDIO_IN_SetBitsPerSample(uint32_t Instance, uint32_t BitsPerSample);
int32_t BSP_AUDIO_IN_GetBitsPerSample(uint32_t Instance, uint32_t *BitsPerSample);
int32_t BSP_AUDIO_IN_SetChannelsNbr(uint32_t Instance, uint32_t ChannelNbr);
int32_t BSP_AUDIO_IN_GetChannelsNbr(uint32_t Instance, uint32_t *ChannelNbr);
int32_t BSP_AUDIO_IN_SetVolume(uint32_t Instance, uint32_t Volume);
int32_t BSP_AUDIO_IN_GetVolume(uint32_t Instance, uint32_t *Volume);
int32_t BSP_AUDIO_IN_GetState(uint32_t Instance, uint32_t *State);

/* Specific PDM recodr APIs */
int32_t BSP_AUDIO_IN_PDMToPCM_Init(uint32_t Instance, uint32_t AudioFreq, uint32_t ChnlNbrIn, uint32_t ChnlNbrOut);
int32_t BSP_AUDIO_IN_PDMToPCM(uint32_t Instance, uint16_t *PDMBuf, uint16_t *PCMBuf);

void BSP_AUDIO_IN_IRQHandler(uint32_t Instance, uint32_t Device);

/* User Callbacks: user has to implement these functions in his code if they are needed. */
/* This function should be implemented by the user application.
   It is called into this driver when the current buffer is filled to prepare the next
   buffer pointer and its size. */
void BSP_AUDIO_IN_TransferComplete_CallBack(uint32_t Instance);
void BSP_AUDIO_IN_HalfTransfer_CallBack(uint32_t Instance);

/* This function is called when an Interrupt due to transfer error on or peripheral
   error occurs. */
void BSP_AUDIO_IN_Error_CallBack(uint32_t Instance);

/**
  * @}
  */

/** @addtogroup BSP_AUDIO_IN_Private_Functions
  * @{
  */
HAL_StatusTypeDef MX_SAI_ClockConfig(SAI_HandleTypeDef *hSai);
HAL_StatusTypeDef MX_SAI1_Block_A_Init(SAI_HandleTypeDef* hsai,uint32_t PDM_FREQ);

/**
  * @}
  */

/**
  * @}
  */

/**
  * @}
  */

/**
  * @}
  */

#ifdef __cplusplus
}
#endif

#endif /* STM32WB5MM_DK_AUDIO_H */
```

## src/stm32wb5mm_dk_conf.h
```c
/**
  ******************************************************************************
  * @file    stm32wb5mm_dk_conf_template.h
  * @author  MCD Application Team
  * @brief   configuration file.
  *          This file should be copied to the application folder and renamed
  *          to stm32wb5mm_dk_conf.h
  ******************************************************************************
  * @attention
  *
  * Copyright (c) 2019-2021 STMicroelectronics.
  * All rights reserved.
  *
  * This software is licensed under terms that can be found in the LICENSE file
  * in the root directory of this software component.
  * If no LICENSE file comes with this software, it is provided AS-IS.
  *
  ******************************************************************************
  */

/* Define to prevent recursive inclusion -------------------------------------*/
#ifndef STM32WB5MM_DK_CONF_H
#define STM32WB5MM_DK_CONF_H

#ifdef __cplusplus
extern "C" {
#endif

/* Includes ------------------------------------------------------------------*/
#include "stm32wbxx_hal.h"

/* Environmental Sensors usage */
#define USE_ENV_SENSOR_STTS22H_0             1U
#define USE_ENV_SENSOR_LPS22HH_0             0U

/* Motion Sensors usage */
#define USE_MOTION_SENSOR_ISM330DHCX_0       1U
#define USE_MOTION_SENSOR_IIS2MDC_0          0U

/* COM port usage */
#if defined(USE_VCP_CONNECTION)
#define USE_BSP_COM_FEATURE                  1U
#define USE_COM_LOG                          1U
#else
#define USE_BSP_COM_FEATURE                  0U
#define USE_COM_LOG                          0U
#endif /* USE_VCP_CONNECTION */

/* IRQ priorities */
#define BSP_BUTTON_USERx_IT_PRIORITY         0x0FUL
#define PWM_LED_CLOCK_IT_PRIORITY            0x03UL

/* I2C3 Frequency in Hz  */
#define BUS_I2C3_FREQUENCY                   100000UL /* Frequency of I2C3 = 100 KHz*/

/* Indicates whether or not TCXO is supported by the board
 * 0: TCXO not supported
 * 1: TCXO supported
 */
#define IS_TCXO_SUPPORTED                   0U

/* Indicates whether or not DCDC is supported by the board
 * 0: DCDC not supported
 * 1: DCDC supported
 */
#define IS_DCDC_SUPPORTED                   1U

#define STM32WB5MM_DK_I2C_Init BSP_I2C3_Init
#define STM32WB5MM_DK_I2C_DeInit BSP_I2C3_DeInit
#define STM32WB5MM_DK_I2C_ReadReg BSP_I2C3_ReadReg
#define STM32WB5MM_DK_I2C_WriteReg BSP_I2C3_WriteReg
  
#define STM32WB5MM_DK_GetTick BSP_GetTick

/*Number of millisecond of audio at each DMA interrupt*/
#define N_MS_PER_INTERRUPT               (20U)
 
#define AUDIO_IN_CHANNELS               1
#define AUDIO_IN_SAMPLING_FREQUENCY     16000

#define AUDIO_CHANNELS_OUT              1
#define AUDIO_OUT_SAMPLING_FREQUENCY    16000

#define AUDIO_IN_BUFFER_SIZE            DEFAULT_AUDIO_IN_BUFFER_SIZE  
  
#if (AUDIO_IN_SAMPLING_FREQUENCY == 8000)
#define MAX_DECIMATION_FACTOR 160
#else
#define MAX_DECIMATION_FACTOR 128
#endif

#define MAX_MIC_FREQ                      1280  /*kHz - Maximum PDM clock */
#define MAX_AUDIO_IN_CHANNEL_NBR_PER_IF   1 /* Maximum number of microhpones channels for peripheral interface */
#define MAX_AUDIO_IN_CHANNEL_NBR_TOTAL    1

#ifdef __cplusplus
}
#endif

#endif /* STM32WB5MM_DK_CONF_H */
```
