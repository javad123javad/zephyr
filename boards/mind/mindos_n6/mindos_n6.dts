/*
 * Copyright (c) 2025 STMicroelectronics
 *
 * SPDX-License-Identifier: Apache-2.0
 */

/dts-v1/;
#include "mindos_n6_common.dtsi"

/ {
	model = "MindOS N6 MCU board";
	compatible = "st,stm32n657l0-mindos";
};
