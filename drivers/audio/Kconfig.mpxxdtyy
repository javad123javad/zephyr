## drivers/audio/Kconfig.mpxxdtyy
```kconfig
# Copyright (c) 2018 STMicroelectronics
# SPDX-License-Identifier: Apache-2.0

config AUDIO_MPXXDTYY
	bool "ST Digital PDM microphone attached to I2S support"
	default y
	depends on DT_HAS_ST_MPXXDTYY_ENABLED
	select I2S
	select SAI
	select SPI
	select HAS_STLIB
	help
	  Enable MPXXDTYY microphone support on the selected board
```

## drivers/led/Kconfig.tlc59731
```kconfig
# Copyright (c) 2024 Javad Rahimipetroudi <javad.rahimipetroudi@mind.be>
# SPDX-License-Identifier: Apache-2.0

config TLC59731
        bool "TLC59731 LED controller"
        default y
        depends on GPIO && DT_HAS_TI_TLC59731_ENABLED
        #select GPIO
        help
          Enable driver for the Texas Instruments TLC59731 EasySet LED
          controllers.
```

## drivers/led_strip/Kconfig.tlc59731
```kconfig
# Copyright (c) 2024 Javad Rahimipetroudi <javad.rahimipetroudi@mind.be>
# SPDX-License-Identifier: Apache-2.0

config TLC59731_STRIP
	bool "TLC59731 LED controller"
	default n
	depends on DT_HAS_TI_TLC59731_ENABLED
	select GPIO
	help
	  Enable driver for the Texas Instruments TLC59731 EasySet LED
	  controllers.
config TLC59731_STRIP_SPI
        bool "TLC59731 LED strip SPI driver"
        default y
        depends on DT_HAS_TI_TLC59731_SPI_ENABLED
	select SPI 
        help
          Enable driver for TLC59731 (and compatibles) LED strip using SPI.
          The SPI driver is portable, but requires significantly more
          memory (1 byte of overhead per bit of pixel data).
```

## dts/bindings/led/ti,tlc59731.yaml
```yaml
# Copyright (c) 2020 Seagate Technology LLC
# SPDX-License-Identifier: Apache-2.0

compatible: "ti,tlc59731"
description: TLC59731 RGB LED Controller

  #child-binding:
  # include: ["led-controller.yaml"]
properties:
  enable-gpios:
    type: phandle-array
    description: |
      GPIO to use to enable/disable the controller.
  gpios:
    required: true
    type: phandle-array
    description: |
      GPIO to send command data to the controller.
  label:
    type: string
    description: |
      RGB Label
```

## dts/bindings/led_strip/ti,tlc59731-spi.yaml
```yaml
# Copyright (c) 2024 Javad Rahimipetroudi <javad.rahimipetroudi@mind.be>
# SPDX-License-Identifier: Apache-2.0

compatible: "ti,tlc59731-spi"
description: TLC59731 SPI RGB LED Controller
include: [spi-device.yaml, tlc59731.yaml]

properties:

  spi-one-frame:
    type: int
    required: true
    description: 8-bit SPI frame to shift out for a 1 pulse.

  spi-zero-frame:
    type: int
    required: true
    description: 8-bit SPI frame to shift out for a 0 pulse.
```

## workspace/hvac/sample.yaml
```yaml
sample:
  description: HVAC simulation sample, the simplest Zephyr
    application
  name: HVAC
common:
  tags: introduction
  integration_platforms:
    - native_sim
  harness: console
  harness_config:
    type: one_line
    regex:
      - "Hello World! (.*)"
tests:
  sample.basic.helloworld:
    tags: introduction
```
